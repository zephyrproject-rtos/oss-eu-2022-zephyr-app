## drivers/led/Kconfig
```kconfig
# Copyright (c) 2021 Nordic Semiconductor ASA
# SPDX-License-Identifier: Apache-2.0

if LED
rsource "Kconfig.led_rgb_pwm"
endif #LED
```

## drivers/led/Kconfig.led_rgb_pwm
```kconfig
config LED_RGB_PWM
	bool "PWM-driven RGB LED"
	default y
	depends on DT_HAS_LED_RGB_PWM_ENABLED
	select PWM
	help
	  PWM-driven RGB LED
```

## dts/bindings/led/led-rgb-pwm.yaml
```yaml
# Copyright (c) 2022 Nordic Semiconductor ASA
# SPDX-License-Identifier: Apache-2.0

description: |
  RGB LED controlled using PWM signals. Example usage:

  led-rgb {
      compatible = "led-rgb-pwm";
      pwms = <&pwm0 0 PWM_MSEC(20) PWM_POLARITY_NORMAL>,
             <&pwm0 1 PWM_MSEC(20) PWM_POLARITY_NORMAL>,
             <&pwm0 2 PWM_MSEC(20) PWM_POLARITY_NORMAL>;
      pwm-names = "red", "green", "blue";
  };

compatible: "led-rgb-pwm"

include: led-controller.yaml

properties:
    pwms:
      required: true
      type: phandle-array

    pwm-names:
      required: true
      type: string-array
```
